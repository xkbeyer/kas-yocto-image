## myproduct/meta-bsp/conf/layer.conf
```bitbake
# We have a conf and classes directory, add to BBPATH
BBPATH =. "${LAYERDIR}:"

# We have recipes-* directories, add to BBFILES
BBFILES += "${LAYERDIR}/recipes-*/*/*.bb \
            ${LAYERDIR}/recipes-*/*/*.bbappend"

BBFILE_COLLECTIONS += "kb"
BBFILE_PATTERN_kb = "^${LAYERDIR}/"
BBFILE_PRIORITY_kb = "5"

LAYERSERIES_COMPAT_kb = "nanbield"

# This should only be incremented on significant changes that will
# cause compatibility issues with other layers
LAYERVERSION_kb = "3"

LAYERDEPENDS_kb = "core"

REQUIRED_POKY_BBLAYERS_CONF_VERSION = "2"
```

## myproduct/meta-bsp/conf/machine/myboard.conf
```bitbake
#@TYPE: Machine
#@NAME: My Board
#@DESCRIPTION: Machine configuration for generic x86_64 (64-bit) PCs and servers. Supports a moderately wide range of drivers that should boot and be usable on "typical" hardware.

DEFAULTTUNE ?= "core2-64"
require conf/machine/genericx86-64.conf
# The magic to make myboard compatible w/ x86-64 machine.
MACHINEOVERRIDES = "genericx86-64:${MACHINE}"


MACHINE_FEATURES += "efi pcbios"
PREFERRED_VERSION_linux-yocto ?= "6.6%"
PREFERRED_PROVIDER_virtual/kernel ?= "linux-yocto"

MACHINE_EXTRA_RRECOMMENDS += "kernel-modules linux-firmware"
IMAGE_FSTYPES += "wic wic.bmap ext4"
EFI_PROVIDER ??= "grub-efi"
do_image_wic[depends] += "gptfdisk-native:do_populate_sysroot"
do_image_wic[recrdeptask] += "do_bootimg"

# hard drive layout.
WKS_FILE = "myboard.wks.in"

#For runqemu
QB_SYSTEM_NAME = "qemu-system-x86_64"
```

## myproduct/meta-xkb/conf/layer.conf
```bitbake
# We have a conf and classes directory, add to BBPATH
BBPATH =. "${LAYERDIR}:"

# We have recipes-* directories, add to BBFILES
BBFILES += "${LAYERDIR}/recipes-*/*/*.bb \
            ${LAYERDIR}/recipes-*/*/*.bbappend"

BBFILE_COLLECTIONS += "xkb"
BBFILE_PATTERN_xkb = "^${LAYERDIR}/"
BBFILE_PRIORITY_xkb = "5"

LAYERSERIES_COMPAT_xkb = "nanbield scarthgap"

# This should only be incremented on significant changes that will
# cause compatibility issues with other layers
LAYERVERSION_xkb = "3"

LAYERDEPENDS_xkb = "core"

REQUIRED_POKY_BBLAYERS_CONF_VERSION = "2"
```
